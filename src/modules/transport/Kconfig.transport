## src/modules/transport/Kconfig.transport
```kconfig
#
# Copyright (c) 2023 Nordic Semiconductor
#
# SPDX-License-Identifier: LicenseRef-Nordic-5-Clause
#

menu "Transport"
	depends on MQTT_HELPER
	depends on HW_ID_LIBRARY

config MQTT_SAMPLE_TRANSPORT_RECONNECTION_TIMEOUT_SECONDS
	int "Reconnection timeout in seconds"
	default 60
	help
	  Time in between reconnection attempts to the MQTT broker.

config MQTT_SAMPLE_TRANSPORT_DUMP_SAMPLE_COUNT
	int "Sensor samples per MQTT transmission burst"
	range 1 256
	default 30
	help
	  Number of sensor samples to collect before connecting to MQTT and
	  publishing them as individual Sparkplug NDATA messages in one burst.
	  With the current 10-second sampling interval, the default collects about
	  five minutes of readings.

config MQTT_SAMPLE_TRANSPORT_SAMPLE_BUFFER_SIZE
	int "Sensor sample buffer size"
	range 1 512
	default 32
	help
	  Maximum number of sensor samples held in RAM while waiting to publish.
	  The buffer must be at least as large as the batch sample count.

config MQTT_SAMPLE_TRANSPORT_PUBLISH_NDEATH_AFTER_DUMP
	bool "Publish Sparkplug NDEATH after each MQTT batch"
	default y
	help
	  Publish a Sparkplug NDEATH message before closing the MQTT connection
	  after each batch, so the host can mark the node offline during the sleep period.

config MQTT_SAMPLE_TRANSPORT_THREAD_STACK_SIZE
	int "Thread stack size"
	default 2048

config MQTT_SAMPLE_TRANSPORT_MESSAGE_QUEUE_SIZE
	int "Message queue size"
	default 5
	help
	  ZBus subscriber message queue size.

config MQTT_SAMPLE_TRANSPORT_WORKQUEUE_STACK_SIZE
	int "Workqueue stack size"
	default 4096
	help
	  Stack size of the module's internal workqueue.

config MQTT_SAMPLE_TRANSPORT_BROKER_HOSTNAME
	string "MQTT broker hostname"
	default "mqtt.nordicsemi.academy"

config MQTT_SAMPLE_TRANSPORT_CLIENT_ID
	string "MQTT Client ID"
	default ""
	help
	  Use a custom client ID string. If not set, the client ID will default to the
	  modem's IMEI number for nRF91 Series devices, MAC address for nRF7 Series devices,
	  or a random number for Native Sim.

config MQTT_SAMPLE_TRANSPORT_CLIENT_ID_BUFFER_SIZE
	int "MQTT Client ID buffer size"
	default 50
	help
	  Size of buffer used to store the MQTT client ID.

config MQTT_SAMPLE_TRANSPORT_PUBLISH_TOPIC
	string "MQTT publish topic"
	default "my/publish/topic"

config MQTT_SAMPLE_TRANSPORT_SUBSCRIBE_TOPIC
	string "MQTT subscribe topic"
	default "my/subscribe/topic"

module = MQTT_SAMPLE_TRANSPORT
module-str = Transport
source "subsys/logging/Kconfig.template.log_config"

endmenu # Transport
```
